## sdkconfig.defaults
```kconfig
# ESP32 sdkconfig defaults for smsgate
# ESP-IDF v5.2 caps this at 60; 120 (config.toml) is enforced by the kick interval
CONFIG_ESP_TASK_WDT_TIMEOUT_S=60
CONFIG_LWIP_DNS_MAX_SERVERS=2
CONFIG_MBEDTLS_CERTIFICATE_BUNDLE=y
CONFIG_ESP_TLS_INSECURE=n
CONFIG_HTTPD_MAX_REQ_HDR_LEN=1024
# Stack size for main task — Rust needs significantly more than the default
CONFIG_ESP_MAIN_TASK_STACK_SIZE=32768
# Enable PSRAM if available (T-A7670X has no PSRAM)
# CONFIG_SPIRAM=n

# ---- Runtime performance ----
# T-A7670X uses a classic ESP32 that supports 240 MHz CPU frequency.
# CONFIG_ESP_DEFAULT_CPU_FREQ_MHZ_80 is not set
# CONFIG_ESP_DEFAULT_CPU_FREQ_MHZ_160 is not set
CONFIG_ESP_DEFAULT_CPU_FREQ_MHZ_240=y
CONFIG_ESP_DEFAULT_CPU_FREQ_MHZ=240

# ---- Wireless features ----
# Bluetooth is unused; keep it disabled so BT controller/host memory is not reserved.
# CONFIG_BT_ENABLED is not set

# Keep classic ESP32 dual-core FreeRTOS enabled.
# CONFIG_FREERTOS_UNICORE is not set

# ---- Flash size (T-A7670X has 4 MB) ----
CONFIG_ESPTOOLPY_FLASHSIZE_4MB=y

# ---- OTA dual-partition layout ----
# Custom partition table with two OTA slots plus a 128 KiB future log ring partition.
CONFIG_PARTITION_TABLE_CUSTOM=y
CONFIG_PARTITION_TABLE_CUSTOM_FILENAME="partitions_ota.csv"
CONFIG_PARTITION_TABLE_OFFSET=0x8000
CONFIG_BOOTLOADER_APP_ROLLBACK_ENABLE=y

# ---- Logging ----
CONFIG_LOG_DEFAULT_LEVEL_INFO=y
CONFIG_LOG_DEFAULT_LEVEL=3
```
